## main/Kconfig.projbuild
```kconfig
menu "Johan2 Player Configuration"
    config JOHAN2_WIFI_SSID
        string "Wi-Fi SSID"
        default ""
    config JOHAN2_WIFI_PASSWORD
        string "Wi-Fi password"
        default ""
    config JOHAN2_PLAYER_NAME
        string "Name shown in Music Assistant"
        default "Johan2 AUX"
    config JOHAN2_SERVER_URL
        string "Optional Sendspin WebSocket URL (blank for discovery)"
        default ""
        help
            Optional ws://HOST:8928/sendspin URL. Normally Music Assistant
            discovers this player through mDNS and connects to it.
    config JOHAN2_I2S_BCLK
        int "PCM5102A BCLK GPIO"
        range 0 48
        default 6
    config JOHAN2_I2S_LRCK
        int "PCM5102A LRCK GPIO"
        range 0 48
        default 5
    config JOHAN2_I2S_DOUT
        int "PCM5102A DIN GPIO"
        range 0 48
        default 4
    config JOHAN2_LED_GPIO
        int "Onboard addressable RGB LED GPIO (-1 disables)"
        range -1 48
        default 48
        help
            ESP32-S3-DevKitC-1 v1.0 uses GPIO48, v1.1 uses GPIO38.
    config JOHAN2_HA_WS_URL
        string "Home Assistant WebSocket URL"
        default "ws://haos.home:8123/api/websocket"
    config JOHAN2_HA_TOKEN
        string "Home Assistant long-lived access token (local sdkconfig only)"
        default ""
        help
            Leave blank to disable Assist. Never commit or log this credential.
    config JOHAN2_HA_PIPELINE
        string "Assist pipeline ID (blank uses preferred assistant)"
        default ""
    config JOHAN2_STOP_LISTENER
        bool "Listen for a spoken stop while an answer is processed or spoken"
        default n
        help
            Runs an extra STT-only Assist session during processing and replies. It costs extra STT
            calls and may transcribe noise or the reply; disabled by default.
    config JOHAN2_HA_REPLY_PLAYER
        string "HA media_player entity for spoken replies (blank disables)"
        default ""
        help
            Set the Music Assistant media_player entity for this Johan2 AUX player.
            Assist generates TTS and forwards it as an announcement via Music Assistant.
    config JOHAN2_TTS_DIRECT
        bool "Play spoken replies directly on this device"
        default y
        help
            Fetch the HA TTS WAV and play it through the DAC, mixed over music.
            Non-WAV replies fall back to the reply media_player, if set.
    config JOHAN2_TTS_VOLUME
        int "Direct reply volume (percent)"
        range 0 100
        default 70
    config JOHAN2_LISTENING_CUE
        bool "Play short beeps when command listening starts and ends"
        default y
        help
            Plays a high local 80 ms cue after the wake word, remote start or a
            follow-up, and a lower cue when command capture ends. Uses the
            direct reply volume. Microphone streaming is
            held during the cue and briefly afterward to keep it out of STT.
    config JOHAN2_WAKE_VAD
        bool "Gate idle wake-word audio with local WebRTC speech detection"
        default y
        help
            Retain 500 ms of audio locally, send it when speech starts, and keep
            sending for one second after speech. Commands, follow-ups and the
            stop listener remain continuous. Disable to restore full streaming.
    config JOHAN2_HOMEDASH_SYNC
        bool "Synchronize Assist state and remote wake via Home Assistant"
        default n
        help
            Requires ha/johan2_assist.yaml on HA and HomeDash remote mode.
            Publishes input_select.johan2_assist_state and subscribes to
            the two input_button.johan2_assist_start/cancel helpers.
    config JOHAN2_HOMEDASH_TRANSCRIPT_URL
        string "HomeDash proxy URL to show what Assist heard (blank disables)"
        default ""
        help
            Example: http://bakkieplus:8767/transcript. The HomeDash proxy shows
            the recognised text on its wall display.
    config JOHAN2_HOMEDASH_LIGHT_PORT
        int "HomeDash proxy UDP port for the LED colour mirror (0 disables)"
        range 0 65535
        default 8768
        help
            Johan2 sends its RGB LED colour here about ten times a second. The
            host is taken from the HomeDash proxy URL above.
    config JOHAN2_MIC_GAIN
        int "Microphone PCM gain for Assist"
        range 1 32
        default 16
    config JOHAN2_MIC_HIGHPASS_HZ
        int "Microphone rumble high-pass cutoff (Hz; 0 disables)"
        range 0 300
        default 100
        help
            Second-order Butterworth high-pass before Assist gain/clipping.
            100 Hz suppresses low rumble. 0 retains the original DC removal.
    config JOHAN2_MIC_PROFILE_DENOISE
        bool "Enable Johan2 measured-profile microphone noise suppression"
        default n
        help
            Experimental spectral suppression derived from noisy/quiet recordings.
            Adds 32 ms fixed latency and uses about 20 KB fixed RAM.
            Operates before gain/clipping; disable for unprocessed comparison.
    config JOHAN2_MIC_AEC
        bool "Experimental playback-reference acoustic echo cancellation"
        default n
        help
            Uses ESP-SR AEC before microphone filtering/gain, with a timestamped
            mono reference from actual DAC DMA output (music and direct TTS).
            Uses 32 ms frames and 16 ms reference lookahead. Needs physical
            validation with music.
    config JOHAN2_MIC_AEC_DELAY_MS
        int "Additional acoustic reference delay (ms)"
        depends on JOHAN2_MIC_AEC
        range 0 150
        default 0
        help
            Delays the playback reference relative to the microphone. Start at
            zero for a directly connected DAC/amp; increase for delayed speakers.
    config JOHAN2_MIC_DIAGNOSTICS
        bool "Enable on-demand microphone WAV recording on HTTP port 8081"
        default n
        help
            GET /mic.wav records 15 seconds of Assist-input PCM in PSRAM.
            No authentication: enable temporarily on a trusted LAN only.
            Audio is erased after download; no flash storage is used.
endmenu
```

## sdkconfig.defaults
```kconfig
CONFIG_ESPTOOLPY_FLASHSIZE_16MB=y
CONFIG_PARTITION_TABLE_CUSTOM=y
CONFIG_PARTITION_TABLE_CUSTOM_FILENAME="partitions.csv"
CONFIG_SPIRAM=y
CONFIG_SPIRAM_MODE_OCT=y
CONFIG_SPIRAM_SPEED_80M=y
CONFIG_SPIRAM_USE_MALLOC=y
CONFIG_ESP_DEFAULT_CPU_FREQ_MHZ_240=y
CONFIG_ESP_MAIN_TASK_STACK_SIZE=8192
CONFIG_COMPILER_CXX_EXCEPTIONS=y
CONFIG_MBEDTLS_CERTIFICATE_BUNDLE=y
CONFIG_MBEDTLS_CERTIFICATE_BUNDLE_DEFAULT_FULL=y
CONFIG_SENDSPIN_ENABLE_PLAYER=y
# CONFIG_SENDSPIN_ENABLE_CONTROLLER is not set
# CONFIG_SENDSPIN_ENABLE_METADATA is not set
# CONFIG_SENDSPIN_ENABLE_COLOR is not set
# CONFIG_SENDSPIN_ENABLE_ARTWORK is not set
# CONFIG_SENDSPIN_ENABLE_VISUALIZER is not set

# Restore the scheduler rate used by the working 0.2.0 firmware.
CONFIG_FREERTOS_HZ=100
```
